/* MCUboot's view of the Matter variant's flash layout: the application's (boards/matter_partitions.dtsi). */
#include "../../../boards/matter_partitions.dtsi"

/ {
	chosen {
		zephyr,code-partition = &boot_partition;
	};
};
