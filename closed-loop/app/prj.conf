## CMakeLists.txt
```
cmake_minimum_required(VERSION 3.20.0)
if(NOT DEFINED BOARD)
  set(BOARD nrf7002dk/nrf5340/cpuapp CACHE STRING "CRANIUM development board")
endif()
find_package(Zephyr REQUIRED HINTS $ENV{ZEPHYR_BASE})
project(cranium_telemetry)

# Work with both direct west builds and the space-free workbench wrapper.
zephyr_get(CRANIUM_PROFILE SYSBUILD)
if(NOT CRANIUM_PROFILE)
  set(CRANIUM_PROFILE optimized)
endif()
if(NOT CRANIUM_PROFILE MATCHES "^(baseline|optimized)$")
  message(FATAL_ERROR "CRANIUM_PROFILE must be baseline or optimized")
endif()
set(profile_file "${CMAKE_CURRENT_SOURCE_DIR}/profiles/${CRANIUM_PROFILE}.json")
set_property(DIRECTORY APPEND PROPERTY CMAKE_CONFIGURE_DEPENDS "${profile_file}")
file(READ "${profile_file}" profile_json)
string(JSON advertising_ms GET "${profile_json}" advertising_interval_ms)
string(JSON CRANIUM_HEARTBEAT_MS GET "${profile_json}" heartbeat_ms)
string(JSON status_led GET "${profile_json}" status_led)
if(advertising_ms LESS 20 OR advertising_ms GREATER 3200 OR
   CRANIUM_HEARTBEAT_MS LESS 0 OR CRANIUM_HEARTBEAT_MS GREATER 5000)
  message(FATAL_ERROR "Profile outside bounded BLE/heartbeat settings")
endif()
math(EXPR CRANIUM_ADV_UNITS "(${advertising_ms} * 8 + 2) / 5")
if(status_led)
  set(CRANIUM_STATUS_LED 1)
else()
  set(CRANIUM_STATUS_LED 0)
endif()
configure_file(src/profile.h.in generated/profile.h @ONLY)
target_sources(app PRIVATE src/main.c src/protocol.c)
target_include_directories(app PRIVATE src "${CMAKE_CURRENT_BINARY_DIR}/generated")
```

## west.yml
```
manifest:
  version: "0.13"
  self:
    path: app
  projects:
    - name: nrf
      url: https://github.com/nrfconnect/sdk-nrf
      # NCS v3.4.0, identical to the SDK used to validate this project.
      revision: 99553055607b2e9885fbc80ccd11fa9da81c2df0
      path: nrf
      import:
        # Keep fetched SDK sources separate from our tools/ and source files.
        path-prefix: deps
```

## prj.conf
```kconfig
CONFIG_GPIO=y
CONFIG_SERIAL=y
CONFIG_UART_INTERRUPT_DRIVEN=y
CONFIG_CONSOLE=n
CONFIG_UART_CONSOLE=n
CONFIG_LOG=n
CONFIG_PRINTK=n
CONFIG_BT=y
CONFIG_BT_PERIPHERAL=y
CONFIG_BT_DEVICE_NAME="CRANIUM-Link"
CONFIG_BT_MAX_CONN=1
CONFIG_BT_NUS=y
CONFIG_BT_SMP=y
CONFIG_BT_BONDABLE=n
CONFIG_MAIN_STACK_SIZE=4096
CONFIG_SYSTEM_WORKQUEUE_STACK_SIZE=2048
CONFIG_HEAP_MEM_POOL_SIZE=8192
CONFIG_ASSERT=y
```

## boards/nrf7002dk_nrf5340_cpuapp.overlay
```dts
/* Keep UART0 at the DK's debug VCOM pins: TX=P0.20, RX=P0.22. */
&uart0 {
    status = "okay";
    current-speed = <115200>;
    /delete-property/ hw-flow-control;
};
/* This BLE companion does not initialize the Wi-Fi companion or QSPI. */
&qspi { status = "disabled"; };
```

## src/main.c
```c
/* SPDX-License-Identifier: MIT
 * CRANIUM laboratory companion: bounded UART ingress -> NUS notifications.
 * ACK confirms validated UART receipt, never unverified radio delivery.
 */
#include <zephyr/kernel.h>
#include <zephyr/drivers/gpio.h>
#include <zephyr/drivers/uart.h>
#include <zephyr/bluetooth/bluetooth.h>
#include <zephyr/bluetooth/conn.h>
#include <zephyr/bluetooth/gatt.h>
#include <bluetooth/services/nus.h>
#include <stdio.h>
#include <string.h>
#include "protocol.h"
#include "profile.h"
struct input_line { size_t length; char data[CRANIUM_FRAME_MAX]; };
K_MSGQ_DEFINE(lines,sizeof(struct input_line),4,4);
K_MSGQ_DEFINE(radio,sizeof(struct cranium_frame),4,4);
static const struct device *uart=DEVICE_DT_GET(DT_NODELABEL(uart0));
static const struct gpio_dt_spec led=GPIO_DT_SPEC_GET(DT_ALIAS(led0),gpios);
static atomic_t subscribed;
static atomic_t secured;
static struct k_work advertising;
static void send_text(const char *text) { for(size_t i=0;text[i];i++) uart_poll_out(uart,text[i]); }
static void irq(const struct device *dev,void *unused) {
    ARG_UNUSED(unused); static struct input_line current; static bool overflow;
    uint8_t c;
    if(!uart_irq_update(dev)) return;
    while(uart_irq_rx_ready(dev) && uart_fifo_read(dev,&c,1)==1) {
        if(c=='\n') {
            if(!overflow) { current.data[current.length++]='\n'; k_msgq_put(&lines,&current,K_NO_WAIT); }
            current.length=0; overflow=false;
        } else if(current.length<sizeof(current.data)-2 && !overflow) current.data[current.length++]=(char)c;
        else overflow=true;
    }
}
static void enable_notify(enum bt_nus_send_status status) { atomic_set(&subscribed,status==BT_NUS_SEND_STATUS_ENABLED); }
static struct bt_nus_cb nus_callbacks={ .send_enabled=enable_notify };
static const struct bt_data ad[]={BT_DATA_BYTES(BT_DATA_FLAGS,BT_LE_AD_GENERAL|BT_LE_AD_NO_BREDR),BT_DATA(BT_DATA_NAME_COMPLETE,CONFIG_BT_DEVICE_NAME,sizeof(CONFIG_BT_DEVICE_NAME)-1)};
static const struct bt_data sd[]={BT_DATA_BYTES(BT_DATA_UUID128_ALL,BT_UUID_NUS_VAL)};
static void advertise(struct k_work *work) {
    ARG_UNUSED(work);
    struct bt_le_adv_param params=BT_LE_ADV_PARAM_INIT(BT_LE_ADV_OPT_CONN,CRANIUM_ADV_UNITS,CRANIUM_ADV_UNITS+16,NULL);
    bt_le_adv_start(&params,ad,ARRAY_SIZE(ad),sd,ARRAY_SIZE(sd));
}
static void disconnected(struct bt_conn *conn,uint8_t reason) {
    ARG_UNUSED(conn); ARG_UNUSED(reason); atomic_clear(&subscribed); atomic_clear(&secured); k_work_submit(&advertising);
}
static void connected(struct bt_conn *conn,uint8_t error) {
    if(!error) bt_conn_set_security(conn,BT_SECURITY_L2);
}
static void security_changed(struct bt_conn *conn,bt_security_t level,enum bt_security_err error) {
    ARG_UNUSED(conn); atomic_set(&secured,!error && level>=BT_SECURITY_L2);
}
BT_CONN_CB_DEFINE(connection_callbacks)={ .connected=connected,.disconnected=disconnected,.security_changed=security_changed };
static void transmit(void *a,void *b,void *c) {
    ARG_UNUSED(a); ARG_UNUSED(b); ARG_UNUSED(c); struct cranium_frame frame;
    while(true) {
        k_msgq_get(&radio,&frame,K_FOREVER);
        if(!atomic_get(&subscribed) || !atomic_get(&secured)) continue;
        frame.payload[frame.length++]='\n';
        for(size_t offset=0;offset<frame.length;) {
            size_t n=MIN((size_t)20,frame.length-offset); int rc=-1;
            for(int tries=0;tries<5;tries++) {
                rc=bt_nus_send(NULL,(const uint8_t *)frame.payload+offset,n);
                if(!rc) break;
                k_msleep(10);
            }
            if(rc) break;
            offset+=n;
        }
    }
}
K_THREAD_DEFINE(radio_thread,2048,transmit,NULL,NULL,NULL,7,0,0);
int main(void) {
    if(!device_is_ready(uart)) return 1;
    if(!gpio_is_ready_dt(&led)) return 2;
    gpio_pin_configure_dt(&led,GPIO_OUTPUT_INACTIVE);
    k_work_init(&advertising,advertise);
    if(bt_enable(NULL) || bt_nus_init(&nus_callbacks)) return 3;
    k_work_submit(&advertising);
    uart_irq_callback_user_data_set(uart,irq,NULL); uart_irq_rx_enable(uart);
    send_text("CRANIUM:READY:" CRANIUM_PROFILE "\n");
    struct input_line line; uint32_t previous=0; bool initialized=false,light=false;
    while(true) {
        int ready=k_msgq_get(&lines,&line,CRANIUM_HEARTBEAT_MS?K_MSEC(CRANIUM_HEARTBEAT_MS):K_FOREVER);
        if(CRANIUM_STATUS_LED) { light=!light; gpio_pin_set_dt(&led,light); }
        if(ready) continue;
        struct cranium_frame frame; enum cranium_result result=cranium_parse(line.data,line.length,&frame);
        if(result==CRANIUM_OK && !cranium_sequence_new(frame.seq,previous,initialized)) result=CRANIUM_DUP;
        if(result==CRANIUM_OK) { previous=frame.seq; initialized=true; }
        const char *status=result==CRANIUM_OK?"OK":result==CRANIUM_CRC?"CRC":result==CRANIUM_DUP?"DUP":"FRAME";
        bool queued=result==CRANIUM_OK && atomic_get(&subscribed) && atomic_get(&secured) && !k_msgq_put(&radio,&frame,K_NO_WAIT);
        char reply[72]; snprintf(reply,sizeof(reply),"ACK:%u:%s:%u\n",frame.seq,status,queued?1:0); send_text(reply);
    }
}
```

## src/protocol.c
```c
/* SPDX-License-Identifier: MIT */
#include "protocol.h"
#include <string.h>
uint16_t cranium_crc(const void *data, size_t length) {
    const uint8_t *bytes=data; uint16_t crc=0xffff;
    for(size_t i=0;i<length;i++) {
        crc ^= (uint16_t)bytes[i]<<8;
        for(int b=0;b<8;b++) crc=(crc&0x8000)?(uint16_t)((crc<<1)^0x1021):(uint16_t)(crc<<1);
    }
    return crc;
}
static bool decimal(const char **at,const char *end,uint32_t *value) {
    uint32_t v=0; const char *p=*at; bool any=false;
    while(p<end && *p>='0' && *p<='9') {
        uint32_t d=(uint32_t)(*p-'0');
        if(v>(UINT32_MAX-d)/10) return false;
        v=v*10+d; p++; any=true;
    }
    if(!any || p>=end || *p!=':') return false;
    *at=p+1; *value=v; return true;
}
enum cranium_result cranium_parse(const char *line,size_t n,struct cranium_frame *out) {
    memset(out,0,sizeof(*out));
    if(n<14 || n>=CRANIUM_FRAME_MAX || memcmp(line,"C1:",3)) return CRANIUM_FRAME;
    if(line[n-1]=='\n') n--;
    if(n && line[n-1]=='\r') n--;
    const char *end=line+n,*p=line+3; uint32_t length;
    if(!decimal(&p,end,&out->seq) || !decimal(&p,end,&length) || length>CRANIUM_PAYLOAD_MAX) return CRANIUM_FRAME;
    if((size_t)(end-p)!=(size_t)length+5 || p[length]!='*') return CRANIUM_FRAME;
    for(uint32_t i=0;i<length;i++) if(p[i]=='\n'||p[i]=='\r'||p[i]=='\0') return CRANIUM_FRAME;
    uint16_t expected=0;
    for(int i=1;i<=4;i++) {
        char c=p[length+i]; int digit=(c>='0'&&c<='9')?c-'0':(c>='A'&&c<='F')?c-'A'+10:(c>='a'&&c<='f')?c-'a'+10:-1;
        if(digit<0) return CRANIUM_FRAME;
        expected=(uint16_t)((expected<<4)|digit);
    }
    if(cranium_crc(line,(size_t)(p+length-line))!=expected) return CRANIUM_CRC;
    memcpy(out->payload,p,length); out->length=length;
    return CRANIUM_OK;
}
bool cranium_sequence_new(uint32_t seq,uint32_t previous,bool initialized) {
    return !initialized || (int32_t)(seq-previous)>0;
}
```

## src/protocol.h
```c
/* SPDX-License-Identifier: MIT */
#ifndef CRANIUM_PROTOCOL_H
#define CRANIUM_PROTOCOL_H
#include <stdbool.h>
#include <stddef.h>
#include <stdint.h>
#define CRANIUM_PAYLOAD_MAX 480
#define CRANIUM_FRAME_MAX 520
enum cranium_result { CRANIUM_OK, CRANIUM_FRAME, CRANIUM_CRC, CRANIUM_DUP };
struct cranium_frame { uint32_t seq; size_t length; char payload[CRANIUM_PAYLOAD_MAX+1]; };
uint16_t cranium_crc(const void *data, size_t length);
enum cranium_result cranium_parse(const char *line, size_t length, struct cranium_frame *out);
bool cranium_sequence_new(uint32_t seq, uint32_t previous, bool initialized);
#endif
```
